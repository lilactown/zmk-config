clj_defn: clj_defn {
  compatible = "zmk,behavior-macro";
  label = "ZM_clj_defn";
  #binding-cells = <0>;
  wait-ms = <30>;
  tap-ms = <0>;
  bindings
    = <&kp LPAR &kp D &kp E &kp F &kp N>
    , <&kp SPC &kp SPC>
    , <&kp LBKT &kp RBKT &kp RPAR>
    , <&kp LEFT &kp LEFT &kp LEFT &kp LEFT>;
};

clj_fn: clj_fn {
  compatible = "zmk,behavior-macro";
  label = "ZM_clj_fn";
  #binding-cells = <0>;
  wait-ms = <30>;
  tap-ms = <0>;
  bindings
    = <&kp LPAR &kp F &kp N>
    , <&kp SPC>
    , <&kp LBKT &kp RBKT &kp RPAR>
    , <&kp LEFT>;
};

clj_let: clj_let {
  compatible = "zmk,behavior-macro";
  label = "ZM_clj_let";
  #binding-cells = <0>;
  wait-ms = <30>;
  tap-ms = <0>;
  bindings
    = <&kp LPAR &kp L &kp E &kp T>
    , <&kp SPC>
    , <&kp LBKT &kp RBKT &kp RPAR>
    , <&kp LEFT>;
};
